## drivers/adc/Kconfig.mcp342x
```kconfig
# MCP342X ADC configuration options

# Copyright (c) 2023 Diodes Delight.
# SPDX-License-Identifier: Apache-2.0

config ADC_MCP342X
	bool "Microchip MCP342X ADC driver"
	depends on DT_HAS_MICROCHIP_MCP3421_ENABLED
	select I2C
	select ADC_CONFIGURABLE_INPUTS
	help
	  Enable the driver implementation for the MCP342X series
```

## dts/bindings/adc/microchip,mcp3421.yaml
```yaml
description: Microchip MCP3421

compatible: "microchip,mcp3421"

include: microchip,mcp342x-base.yaml
```

## dts/bindings/adc/microchip,mcp342x-base.yaml
```yaml
# Common fields for Microchip MCP342x ADCs

include: [adc-controller.yaml, i2c-device.yaml]

properties:
  "#io-channel-cells":
    const: 1

io-channel-cells:
  - input
```
